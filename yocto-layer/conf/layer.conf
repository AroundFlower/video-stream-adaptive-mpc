## yocto-layer/conf/layer.conf
```bitbake
# Layer conf for meta-video-stream
BBPATH .= ":${LAYERDIR}"

BBFILES += "${LAYERDIR}/recipes-*/*/*.bb \
            ${LAYERDIR}/recipes-*/*/*.bbappend"

BBFILE_COLLECTIONS += "video-stream"
BBFILE_PATTERN_video-stream = "^${LAYERDIR}/"
BBFILE_PRIORITY_video-stream = "6"

LAYERDEPENDS_video-stream = "core openembedded-layer"
LAYERSERIES_COMPAT_video-stream = "dunfell"
```
